## Kernel/drivers/level/Kconfig
```kconfig
config LEVEL_VICTORY
	bool "level support for victory"
	default n 
	help
         Select for level device support
```

## Kernel/drivers/mmc/Kconfig.bak
```kconfig
#
# MMC subsystem configuration
#

menuconfig MMC
	tristate "MMC/SD/SDIO card support"
	depends on HAS_IOMEM
	help
	  This selects MultiMediaCard, Secure Digital and Secure
	  Digital I/O support.

	  If you want MMC/SD/SDIO support, you should say Y here and
	  also to your specific host controller driver.

config MMC_DEBUG
	bool "MMC debugging"
	depends on MMC != n
	help
	  This is an option for use by developers; most people should
	  say N here.  This enables MMC core and driver debugging.
config MMC_VICTORY
	bool "MMC/SD/SDIO card support for victory"
	depends on MMC
config MMC_ATLAS
	bool "MMC/SD/SDIO card support for atlas"
	depends on MMC
if MMC
if MMC_VICTORY

source "drivers/mmc/victory/core/Kconfig"

source "drivers/mmc/victory/card/Kconfig"

source "drivers/mmc/victory/host/Kconfig"

endif # MMC_VICTORY
if MMC_ATLAS

source "drivers/mmc/atlas/core/Kconfig"

source "drivers/mmc/atlas/card/Kconfig"

source "drivers/mmc/atlas/host/Kconfig"

endif # MMC_ATLAS
endif
```

## Kernel/drivers/onedram_s1ntt/Kconfig
```kconfig
#
# OneDRAM configuration
#
menuconfig SAMSUNG_PHONE_TTY
	tristate "Samsung Phone Interface - TTY"
	default m
	---help---
	  By default, n
	  When in doubt, say N.

if SAMSUNG_PHONE_TTY

choice
	prompt "Phone image read by file"
	depends on SAMSUNG_PHONE_TTY
	default ONEDRAM_READ_FILE
	help
		Select the desired split between kernel and user memory.

		If you are not absolutely sure what you are doing, leave this
		option alone!

	config ONEDRAM_READ_FILE
		bool "READ BY FILE"
	config ONEDRAM_READ_FSR
		bool "READ BY FSR"
endchoice

config ONEDRAM_DGSINFO
	bool "Load DGS Info By OneDRAM"
	depends on SAMSUNG_PHONE_TTY
	default y
	help
		Load DGS Info By OneDRAM

config ONEDRAM_HWREV
	bool "HW REV on OneDRAM"
	depends on SAMSUNG_PHONE_TTY
	default y
	help
		HW Revision


config ONEDRAM_TX_RETRY
	int "tx retry when fail"
	range 1 100
	default 10
	help
		TX retry count
		
config ONEDRAM_CHECKBIT
	bool "Using checkbit"
	depends on SAMSUNG_PHONE_TTY
	default n
	help
		Using check bit

config ONEDRAM_IRQPENDING
	bool "IRQ Pending"
	depends on SAMSUNG_PHONE_TTY
	default n
	help
		Interrupt IRQ Pending


config ONEDRAM_IRQ_PENDING
	bool "Using IRQ Pending"
	depends on SAMSUNG_PHONE_TTY
	default n
	help
		IRQ Pending

endif # SAMSUNG_PHONE_TTY
```

## Kernel/drivers/onedram_svn/Kconfig
```kconfig
#
#
#

menuconfig SAMSUNG_PHONE_SVNET
	tristate "Samsung Phone Interface - SVN"
	default n
	---help---
		I love you.
config SAMSUNG_PHONE_SVNET_VICTORY
	tristate "Samsung Phone Interface - SVN for victory"
	depends on SAMSUNG_PHONE_SVNET
config SAMSUNG_PHONE_SVNET_ATLAS
	tristate "Samsung Phone Interface - SVN for atlas"
	depends on SAMSUNG_PHONE_SVNET
if SAMSUNG_PHONE_SVNET

menuconfig PHONE_MODEMCTL 
	tristate "Modem Control"
	depends on SAMSUNG_PHONE_SVNET
	default m
	help
	  Say Y to enable Modem Control support.

menuconfig PHONE_ONEDRAM
	tristate "OneDRAM"
	depends on SAMSUNG_PHONE_SVNET
	default m
	help
	  Say Y to enable OneDRAM Interface support.

menuconfig PHONE_SVNET
	tristate "Samsung Virtual Network"
	depends on SAMSUNG_PHONE_SVNET
	default m
	help
	  Say Y to enable Samsung Virtual Network support

endif # SAMSUNG_PHONE_SVNET
```

## Kernel/drivers/sensor/Kconfig
```kconfig
menuconfig SENSOR
	bool "Sensors Support"
	help
	  Say Y to enable Sensors support.  This allows control of supported
	  Sensors.
if SENSOR

source "drivers/sensor/accel/Kconfig"

source "drivers/sensor/compass/Kconfig"

source "drivers/sensor/optical/Kconfig"
if S5PV210_GARNETT_DELTA
source "drivers/sensor/ags04/Kconfig"
endif
endif # SENSOR
```

## Kernel/drivers/sensor/accel/Kconfig
```kconfig
#
# Accelerometer Sensor Configuration
#



config ACCEL                                                              
	bool "Accelerometer Sensor"
	default y
	help
	This option enables accelerometer sensors  
	   

config ACCEL_BMA020
	depends on ACCEL
	tristate "BMA020 driver for s5pc110"
	default n
	help
	  This option enables accelerometer sensors using bma020 driver.

config ACCEL_SMB380
	depends on ACCEL
	tristate "ACCEL_SMB380 driver for s5pc110"
	default y
	help
	  This option enables accelerometer sensors using bma020 driver.
	  It is optimized for s3c6410.

	  

config ACCEL_KR3DH
        depends on ACCEL
        tristate "KR3DH driver for s5pc11x"
        default y
        help
          This option enables accelerometer sensors using kr3dh driver.
          It is optimized for s5pc11x.
```

## Kernel/drivers/sensor/ags04/Kconfig
```kconfig
config GRIP_SENSOR_AGS04
	
	tristate "Grip sensor support"
	default m
	help 
		This option enables grip sensor support 
	
		
```

## Kernel/drivers/sensor/compass/Kconfig
```kconfig
#
# MAGNETIC Sensor Configuration
#

config COMPASS
	bool "Sensors"
	default n
	help
	  This option enables sensors


config COMPASS_YAMAHA
	depends on COMPASS
	tristate "YAMAHA"
	default y
	help
	  This option enables magnetic sensors using YAMAHA driver.
	  It is optimized for s3c6410.


if COMPASS_YAMAHA

config COMPASS_YAMAHA_ATLAS
        tristate "Atlas yamaha sensor"
        depends on COMPASS
        help
        Atlas yamaha sensor

config  COMPASS_YAMAHA_VICTORY

        tristate "Victory yamaha sensor"
        depends on COMPASS
        help
         Victory yamaha sensor
endif
```

## Kernel/drivers/sensor/optical/Kconfig
```kconfig
#
# Optical Sensor Configuration
#



config OPTICAL                                                              
	bool "Optical Sensor"
	default n
	help
	This option enables proximity & light sensors  
	   

config OPTICAL_GP2A
	depends on OPTICAL
	tristate "GP2A driver for s5pc110"
	default y
	help
	  This option enables proximity & light sensors using gp2a driver.
	  It is optimized for s3c6410.
	  

if OPTICAL_GP2A

config OPTICAL_GP2A_ATLAS

        tristate "Select Atlas optical Sensor"
        depends on OPTICAL
        help
        Atlas optical sensor

config  OPTICAL_GP2A_VICTORY
        tristate "select Victory optical Sensor"
        depends on OPTICAL
        help
        Victory optical sensor
endif
```

## Kernel/drivers/video/samsung_mipi/Kconfig
```kconfig
#
# S3C Video configuration
#

config FB_S3C
	tristate "S3C Framebuffer support (MIPI interface) "
	select FB_CFB_FILLRECT
	select FB_CFB_COPYAREA
	select FB_CFB_IMAGEBLIT
	select FRAMEBUFFER_CONSOLE_DETECT_PRIMARY
	depends on FB && ARCH_S5PV210
	default n
	---help---
	  This enables support for Samsung Display Controller (FIMD)

config VIDEO_SAMSUNG_MEMSIZE_FIMD
	int "Memory size in kbytes for FIMD"
	depends on FB_S3C
	default "3720"

config VIDEO_FB_PHY_ADDR
	hex "Frame buffer address used by bootloader"
	default 0x4F800000
	depends on S5PV210_GARNETT_DELTA
	---help---
		In case you do not want to use FB address in kernel same as bootloader
	        then pass 0.(0x4F800000 is used in bootloader for Garnett)

config FB_S3C_DEBUG
        bool "S3C Framebuffer debug messages"
        depends on FB_S3C

config FB_S3C_TRACE_UNDERRUN
	bool "S3C Framebuffer FIFO underrun trace"
	depends on FB_S3C

config FB_S3C_DEFAULT_WINDOW
	int "Default Window (0-4)"
	depends on FB_S3C
	default "1"
	---help---
	  This indicates the default window number, and which is used as console framebuffer

config FB_S3C_YPANSTEP
	int "Vertical Panning Step (0-2)"
	depends on FB_S3C
	default "1"
	---help---
	  This indicates the number of vertical steps for pan display, 0 means no pan display and
	  1 means the double size of video buffer will be allocated for default window

choice
depends on FB_S3C
prompt "Select LCD Type"
default FB_S3C_LTE480WV
config FB_S3C_LTE480WV
	bool "LTE480WV"
	depends on MACH_SMDKC100 || MACH_SMDK6442
	---help---
	  This enables support for Samsung LTE480WV 4.8\" WVGA LCD panel

config FB_S3C_MIPI_LCD
	bool "MIPI LCD"
	depends on (MACH_SMDKC110 || MACH_S5PC110_ARIES)
	---help---
	  This enables support for Samsung MIPI LCD

config FB_S3C_LVDS
	bool "LVDS"
	depends on FB_S3C && (ARCH_S5PV210)
	---help---
	  This enables support for Samsung LVDS LCD panel

endchoice	
```
